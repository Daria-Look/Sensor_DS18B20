//---------------------------------------------------------------------------------------------------------------------
//	DS18B20_C
//---------------------------------------------------------------------------------------------------------------------
#include "ds18b20.h"
//---------------------------------------------------------------------------------------------------------------------
//	задержка с использованием таймера на указанное число микросекунд
//---------------------------------------------------------------------------------------------------------------------
void DelayMicro(int micros){
	TIM10->CNT = 0;
	TIM10->CR1 = 1;
	while((TIM10->CNT) <= micros) {;}
	TIM10->CR1 = 0;
}
//---------------------------------------------------------------------------------------------------------------------
//	иниициализация датчика
//---------------------------------------------------------------------------------------------------------------------
void ds18b20_Reset(){
	HAL_GPIO_WritePin(GPIOA, GPIO_PIN_1, GPIO_PIN_RESET);//низкий уровень
	DelayMicro(500);
  	HAL_GPIO_WritePin(GPIOA, GPIO_PIN_1, GPIO_PIN_SET);  //высокий уровень
  	DelayMicro(1000);
}
//---------------------------------------------------------------------------------------------------------------------
//	запись бита
//---------------------------------------------------------------------------------------------------------------------
void ds18b20_WriteBit(int bit){
	HAL_GPIO_WritePin(GPIOA, GPIO_PIN_1, GPIO_PIN_RESET);//низкий уровень
	DelayMicro(bit ? 3 : 65);

	HAL_GPIO_WritePin(GPIOA, GPIO_PIN_1, GPIO_PIN_SET);  //высокий уровень
	DelayMicro(bit ? 65 : 3);
}
//---------------------------------------------------------------------------------------------------------------------
//	запись байта
//---------------------------------------------------------------------------------------------------------------------
void ds18b20_WriteByte(int dt){
	for (uint8_t i = 0; i < 8; i++){
		ds18b20_WriteBit(dt >> i & 1);
		DelayMicro(5);
	}
}
//---------------------------------------------------------------------------------------------------------------------
//	чтение бита
//---------------------------------------------------------------------------------------------------------------------
int ds18b20_ReadBit(void){
	int bit = 0;
	HAL_GPIO_WritePin(GPIOA, GPIO_PIN_1, GPIO_PIN_RESET);//низкий уровень
	DelayMicro(2);

	HAL_GPIO_WritePin(GPIOA, GPIO_PIN_1, GPIO_PIN_SET);//высокий уровень
	DelayMicro(12);

	bit = HAL_GPIO_ReadPin(GPIOA, GPIO_PIN_1);
	DelayMicro(45);

	return bit;
}
//---------------------------------------------------------------------------------------------------------------------
//	чтение байта
//---------------------------------------------------------------------------------------------------------------------
int ds18b20_ReadByte(void){
	int data = 0;
	for (int i = 0; i < 8; i++)
		data += ds18b20_ReadBit() << i;

	return data;
}
//---------------------------------------------------------------------------------------------------------------------
//	чтение Sctratchpad
//---------------------------------------------------------------------------------------------------------------------
void ds18b20_ReadScratchpad(int *Data){
	ds18b20_Reset();
    ds18b20_WriteByte(0xCC);//SKIP ROM
	ds18b20_WriteByte(0xBE);//READ SCRATCHPAD

	for(int i=0; i<8; i++){
		Data[i] = ds18b20_ReadByte();
	}
}
//---------------------------------------------------------------------------------------------------------------------
//	получение знака
//---------------------------------------------------------------------------------------------------------------------
int ds18b20_GetSign(int dt){
	if (dt&(1<<11)) return 1;

	else return 0;
}
//---------------------------------------------------------------------------------------------------------------------
//	конвертация темепратуры
//---------------------------------------------------------------------------------------------------------------------
float ds18b20_Convert(int dt){
	float t;
	int at, att;
	if(dt>0x800){//отрицательная температура
		at=~dt&0x07FF;
		att=~dt&0x000F;
		t = (float)(((at)+1)>>4)*-1; //отборосим знаковые и дробные биты
		t -= (float)((att)+1) / 16.0f; //вычтем дробную часть
		t = 0;
	}
	else{//не отрицательная температура
		at=dt&0x07FF;
		att=dt&0x000F;
		t = (float)((at)>>4); //отборосим знаковые и дробные биты
		t += (float)(att) / 16.0f; //прибавим дробную часть
	}

	return t;
}
//---------------------------------------------------------------------------------------------------------------------
//	end
//---------------------------------------------------------------------------------------------------------------------
